## conf/layer.conf
```bitbake
# We have a conf and classes directory, add to BBPATH
BBPATH .= ":${LAYERDIR}"

# We have recipes-* directories, add to BBFILES
BBFILES += "${LAYERDIR}/recipes-*/*/*.bb \
            ${LAYERDIR}/recipes-*/*/*.bbappend"

BBFILE_COLLECTIONS += "meta-dac"
BBFILE_PATTERN_meta-dac = "^${LAYERDIR}/"
BBFILE_PRIORITY_meta-dac = "6"

LAYERDEPENDS_meta-dac = "core"
LAYERSERIES_COMPAT_meta-dac = "kirkstone dunfell"

BB_DANGLINGAPPENDS_WARNONLY = "true"

DISTRO_FEATURES:remove = " x11"
DISTRO_FEATURES:remove = " kde"
DISTRO_FEATURES:append = " egl"
DISTRO_FEATURES:append = " opengles2"
DISTRO_FEATURES:remove = " bluetooth"

MIDDLEWARE_ARCH ??= "${TUNE_PKGARCH}"

PACKAGECONFIG:remove:pn-cairo = " opengl"
PACKAGECONFIG:remove:pn-qtbase = " gbm"

PACKAGECONFIG:remove:pn-gstreamer1.0-plugins-bad = "vulkan"

DISTRO_FEATURES:append = " cleanup_gfx"
PREFERRED_PROVIDER_virtual/egl = "${@bb.utils.contains('DISTRO_FEATURES', 'cleanup_gfx', 'libglvnd', 'mesa', d)}"
PREFERRED_PROVIDER_virtual/libgles1 = "${@bb.utils.contains('DISTRO_FEATURES', 'cleanup_gfx', 'libglvnd', 'mesa', d)}"
PREFERRED_PROVIDER_virtual/libgles2 = "${@bb.utils.contains('DISTRO_FEATURES', 'cleanup_gfx', 'libglvnd', 'mesa', d)}"
PREFERRED_PROVIDER_virtual/libgl = "${@bb.utils.contains('DISTRO_FEATURES', 'cleanup_gfx', 'libglvnd', 'mesa', d)}"
PREFERRED_PROVIDER_virtual/mesa = "${@bb.utils.contains('DISTRO_FEATURES', 'cleanup_gfx', 'libglvnd', 'mesa', d)}"

PREFERRED_PROVIDER_virtual/wpebackend = "wpebackend-rdk"
PREFERRED_VERSION_libepoxy = "1.5.3"

RDK_GIT_PROTOCOL = "https"
CMF_GIT_PROTOCOL = "https"
CMF_GIT_BRANCH = "rdk-next"
CMF_GIT_MASTER_BRANCH = "master"
CMF_GIT_ROOT = "git://code.rdkcentral.com/r"
CMF_GITHUB_MASTER_BRANCH ?= "master"
CMF_GITHUB_ROOT ?= "git://github.com/rdkcentral"
CMF_GITHUB_BRANCH = "nobranch=1"
CMF_GITHUB_PROTOCOL = "https"
CMF_GITHUB_SRC_URI_SUFFIX = "protocol=${CMF_GITHUB_PROTOCOL};${CMF_GITHUB_BRANCH}"
RDK_RELEASE ?= "1.99"
RDK_COMPATIBILITY ?= "latest"
#LICENSE_FLAGS_WHITELIST += "commercial_fdk-aac"
LICENSE_FLAGS_ACCEPTED += "commercial_fdk-aac"

DISABLE_STATIC:pn-curl-netflix = ""
SECURITY_STRINGFORMAT:pn-netflix = ""

BBMASK += "${@'' if '${TOPDIR}/../meta-qt5' in d.getVar('BBLAYERS', True) else '/meta-dac-sdk/recipes-example/example/qt-egl-test.bb'}"

require ${@'rdke.inc' if os.path.isdir('${TOPDIR}/../rdke') else 'rdkv.inc'}
```

## meta-dac-image-cobalt/conf/layer.conf
```bitbake
BBFILES += "${LAYERDIR}/recipes-*/*/*.bb \
            ${LAYERDIR}/recipes-*/*/*.bbappend"

BBFILE_COLLECTIONS += "meta-dac-image-cobalt"
BBFILE_PATTERN_meta-dac-image-cobalt = "^${LAYERDIR}/"
BBFILE_PRIORITY_meta-dac-image-cobalt = "100"

LAYERDEPENDS_meta-dac-image-cobalt = "meta-dac"
LAYERSERIES_COMPAT_meta-dac-image-cobalt = "kirkstone"

# a newer version is needed to compile rpcserver
PREFERRED_VERSION_jsoncpp = "1.9.5"

PREFERRED_PROVIDER_virtual/cobalt-evergreen = "${@bb.utils.contains('DISTRO_FEATURES', 'no_pixel_buffer_surfaces', 'cobalt-evergreen-src', 'cobalt-evergreen-pbt', d)}"
```

## meta-dac-image-wpe/conf/layer.conf
```bitbake
BBFILES += "${LAYERDIR}/recipes-*/*/*.bb \
            ${LAYERDIR}/recipes-*/*/*.bbappend"

BBFILE_COLLECTIONS += "meta-dac-image-wpe"
BBFILE_PATTERN_meta-dac-image-wpe = "^${LAYERDIR}/"
BBFILE_PRIORITY_meta-dac-image-wpe = "100"

LAYERDEPENDS_meta-dac-image-wpe = "meta-dac"
LAYERSERIES_COMPAT_meta-dac-image-wpe = "kirkstone dunfell"

OCI_IMAGE_BACKEND = "sloci-image"

BBPATH .= ":${LAYERDIR}/meta-webkit"
BBFILES += "${LAYERDIR}/meta-webkit/recipes-browser/cog/cog_0.16.1.bb"
```
